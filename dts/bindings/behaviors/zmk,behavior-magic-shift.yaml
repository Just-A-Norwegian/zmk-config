## dts/bindings/behaviors/zmk,behavior-magic-shift.yaml
```yaml
# Copyright (c) 2026 The ZMK Contributors
# SPDX-License-Identifier: MIT

description: Magic Shift behavior with one-shot Shift, held Shift, and double-tap Caps Lock

compatible: "zmk,behavior-magic-shift"

include: zero_param.yaml

properties:
  bindings:
    type: phandle-array
    required: true
  hold-term-ms:
    type: int
    default: 200
  double-tap-ms:
    type: int
    default: 250
  one-shot-term-ms:
    type: int
    default: 1000
    description: How long one-shot Shift stays active after the double-tap window closes
```

## dts/bindings/behaviors/zmk,behavior-shortcut-mods.yaml
```yaml
# Copyright (c) 2026 The ZMK Contributors
# SPDX-License-Identifier: MIT

description: Select one hand for home-row shortcut modifiers while holding Delete

compatible: "zmk,behavior-shortcut-mods"

include: zero_param.yaml

properties:
  bindings:
    type: phandle-array
    required: true
```

## dts/bindings/behaviors/zmk,behavior-system-enter.yaml
```yaml
# Copyright (c) 2026 The ZMK Contributors
# SPDX-License-Identifier: MIT

description: Enter behavior that supports Magic Shift and a held System chord

compatible: "zmk,behavior-system-enter"

include: two_param.yaml

properties:
  bindings:
    type: phandles
    required: true
  system-layer:
    type: phandle
    required: true
  tapping-term-ms:
    type: int
    default: 200
  system-chord-term-ms:
    type: int
    default: 200
  first-non-thumb-position:
    type: int
    default: 40
```
