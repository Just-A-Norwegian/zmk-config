## config/west.yml
```yaml
manifest:
  remotes:
    - name: zmkfirmware
      url-base: https://github.com/zmkfirmware
    - name: urob
      url-base: https://github.com/urob
    - name: joelspadin
      url-base: https://github.com/joelspadin
    # Additional modules containing boards/shields/custom code can be listed here as well
    # See https://docs.zephyrproject.org/3.2.0/develop/west/manifest.html#projects
  projects:
    - name: zmk
      remote: zmkfirmware
      revision: v0.3
      import: app/west.yml

    # ZMK modules
    - name: zmk-adaptive-key
      remote: urob
      path: modules/zmk/adaptive-key
      revision: 18cc2795a64ccb394d1a7b7d591a5bfe3f25924b # main (4/19/2026)
    - name: zmk-auto-layer
      remote: urob
      path: modules/zmk/auto-layer
      revision: dfa7c695ffde41ef8064245453595d50e198ae1d # main (4/19/2026)
    - name: zmk-helpers
      remote: urob
      path: modules/zmk/helpers
      revision: 0b9e9d1dd9e86f70b4c8c2b0fab55c4f90c9d2e3 # main (4/19/2026)
    - name: zmk-leader-key
      remote: urob
      path: modules/zmk/leader-key
      revision: 749f7faf65cc4105c82fbe64cfaa7e09a8a63605 # main (4/19/2026)
    - name: zmk-tri-state
      remote: urob
      path: modules/zmk/tri-state
      revision: 2007896c6d5bfb519e8babccf8633841c5647d8b # main (4/19/2026)
    - name: zmk-unicode
      remote: urob
      path: modules/zmk/unicode
      revision: 1a6dbc797a46c4a61c3c71a7a9d013a5d5aee49e # main (4/19/2026)
    - name: zmk-locales
      remote: joelspadin
      path: modules/zmk/locales
      revision: main
  self:
    path: config
```

## zephyr/dts/bindings/behaviors/zmk,behavior-magic-alpha.yaml
```yaml
description: Magic alpha behavior

compatible: "zmk,behavior-magic-alpha"

include: behavior-metadata.yaml

properties:
	label:
		type: string
		required: false
		deprecated: true
	"#binding-cells":
		type: int
		required: true
		const: 1

binding-cells:
	- param1
```

## zephyr/dts/bindings/behaviors/zmk,behavior-magic-mode-tap.yaml
```yaml
description: Magic mode tap behavior

compatible: "zmk,behavior-magic-mode-tap"

properties:
  display-name:
    type: string
  label:
    type: string
    required: false
    deprecated: true
  "#binding-cells":
    type: int
    required: true
    const: 1

binding-cells:
  - param1
```

## zephyr/dts/bindings/behaviors/zmk,behavior-magic-term.yaml
```yaml
description: Magic terminator behavior

compatible: "zmk,behavior-magic-term"

properties:
  display-name:
    type: string
  label:
    type: string
    required: false
    deprecated: true
  "#binding-cells":
    type: int
    required: true
    const: 1

binding-cells:
  - param1
```
